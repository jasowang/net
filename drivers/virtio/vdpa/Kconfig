## drivers/virtio/vdpa/Kconfig
```kconfig
# SPDX-License-Identifier: GPL-2.0-only
config VDPA
	tristate
        default m
        help
          Enable this module to support vDPA device that uses a
          datapath which complies with virtio specifications with
          vendor specific control path.

menuconfig VDPA_MENU
	bool "VDPA drivers"
	default n

if VDPA_MENU

config VDPA_SIM
	tristate "vDPA device simulator"
        select VDPA
        default n
        help
          vDPA networking device simulator which loop TX traffic back
          to RX. This device is used for testing, prototyping and
          development of vDPA.

endif # VDPA_MENU
```
